## KConfig
```kconfig
#
# KConfig
#
# Copyright (C) 2025 Mateusz Stadnik <matgla@live.com>
#
# This program is free software: you can redistribute it and/or
# modify it under the terms of the GNU General Public License
# as published by the Free Software Foundation, either version
# 3 of the License, or (at your option) any later version.
#
# This program is distributed in the hope that it will be
# useful, but WITHOUT ANY WARRANTY; without even the implied
# warranty of MERCHANTABILITY or FITNESS FOR A PARTICULAR
# PURPOSE. See the GNU General Public License for more details.
#
# You should have received a copy of the GNU General
# Public License along with this program. If not, see
# <https://www.gnu.org/licenses/>.
#

mainmenu "Yet Another Simple Operating System"

source "./libs/hal/KConfig"

menu "Process Options"

config CONFIG_PROCESS_USE_MPU_STACK_PROTECTION
  bool "Use MPU Stack Protection"
  help 
    Use hardware unit for stack protection of process
  depends on CPU_HAS_MPU

config CONFIG_PROCESS_USE_STACK_OVERFLOW_DETECTION
  bool "Use stack overflow detection"
  default y
  help 
    Software stack overflow detection. 
    This is detection, not prevention. If stack overflow occured memory may be corrupted!
    For prevention MPU must be used in hardware's that supports it.

config CONFIG_PROCESS_CONTEXT_SWITCH_PERIOD
  int "Context switch period in milliseconds"
  default 20 
  help 
    Context switch period in milliseconds, process may be interrupted earlier if blocked on IO 

config CONFIG_PROCESS_ROOT_STACK_SIZE 
  int "Root process stack size"
  default 4096
  help
    Size of kernel root process stack size

endmenu

menu "Filesystem Options"
  config CONFIG_FS_MAX_MOUNT_POINT_SIZE
  int "Maximum mount point name length in bytes"
  default 64 
  help 
    This is not maximum mounting in terms of depth, since mounting points are linked list

  rsource "source/fs/KConfig"
endmenu
```

## configs/host_defconfig
```kconfig
# CONFIG_CUSTOM_BOARD is not set
CONFIG_BOARD_HOST=y
CONFIG_CONFIG_BOARD="host"
CONFIG_CONFIG_BUILD_BUNDLE_COMPILER_RT=y
# CONFIG_BOARD_MSPC_V2_DISCARD_IN_CONF is not set
CONFIG_CONFIG_BUILD_LINKER_SCRIPT_PATH=""
# CONFIG_BOARD_PIMORONI_PICO_PLUS2_DISCARD_IN_CONF is not set
# CONFIG_BOARD_RASPBERRY_PICO_DISCARD_IN_CONF is not set
# CONFIG_BOARD_RASPBERRY_PICO_2_DISCARD_IN_CONF is not set

#
# CPU Configuration
#
# CONFIG_CPU_ARCH_ARM_ARMV6_M is not set
CONFIG_CONFIG_CPU_ARCH="host"
# CONFIG_CPU_ARCH_ARM_ARMV8_M is not set
CONFIG_CPU_ARCH_STUB_HOST=y
# CONFIG_CPU_CORE_ARM_CORTEX_M0_PLUS is not set
# CONFIG_CPU_CORE_ARM_CORTEX_M33 is not set
CONFIG_CPU_CORE_STUB_HOST=y
CONFIG_CPU_FAMILY_HOST=y
# CONFIG_CPU_FAMILY_RASPBERRY is not set
CONFIG_CPU_HOST=y
CONFIG_CONFIG_CPU="host"
# CONFIG_CPU_RP2040 is not set
# CONFIG_CPU_RP2350 is not set
# end of CPU Configuration

#
# Build options
#
# end of Build options

#
# Memory
#

#
# PSRAM
#
# end of PSRAM
# end of Memory

#
# Process Options
#
CONFIG_CONFIG_PROCESS_USE_STACK_OVERFLOW_DETECTION=y
CONFIG_CONFIG_PROCESS_CONTEXT_SWITCH_PERIOD=20
CONFIG_CONFIG_PROCESS_ROOT_STACK_SIZE=4096
CONFIG_CONFIG_PROCESS_HW_SPINLOCK_NUMBER=5
CONFIG_CONFIG_PROCESS_CONTEXT_SWITCH_HW_SPINLOCK_NUMBER=6
# end of Process Options

#
# Filesystem Options
#
CONFIG_CONFIG_FS_MAX_MOUNT_POINT_SIZE=64
CONFIG_CONFIG_FS_MAX_PATH_LENGTH=64

#
# RamFS Config
#
CONFIG_CONFIG_RAMFS_MAX_FILENAME=16
# end of RamFS Config
# end of Filesystem Options
```

## hal/boards/host/KConfig
```kconfig
# KConfig
#
# Copyright (C) 2025 Mateusz Stadnik <matgla@live.com>
#
# This program is free software: you can redistribute it and/or
# modify it under the terms of the GNU General Public License
# as published by the Free Software Foundation, either version
# 3 of the License, or (at your option) any later version.
#
# This program is distributed in the hope that it will be
# useful, but WITHOUT ANY WARRANTY; without even the implied
# warranty of MERCHANTABILITY or FITNESS FOR A PARTICULAR
# PURPOSE. See the GNU General Public License for more details.
#
# You should have received a copy of the GNU General
# Public License along with this program. If not, see
# <https://www.gnu.org/licenses/>.
#

config BOARD_HOST
  bool "Host"

if BOARD_HOST
  config CONFIG_BOARD 
    def_string "host"   
  
  choice CHOICE_CPU 
    default CPU_HOST 
  endchoice 

  config CONFIG_BUILD_BUNDLE_COMPILER_RT
    default y
endif
```

## hal/boards/raspberry_pico/KConfig
```kconfig
# KConfig
#
# Copyright (C) 2025 Mateusz Stadnik <matgla@live.com>
#
# This program is free software: you can redistribute it and/or
# modify it under the terms of the GNU General Public License
# as published by the Free Software Foundation, either version
# 3 of the License, or (at your option) any later version.
#
# This program is distributed in the hope that it will be
# useful, but WITHOUT ANY WARRANTY; without even the implied
# warranty of MERCHANTABILITY or FITNESS FOR A PARTICULAR
# PURPOSE. See the GNU General Public License for more details.
#
# You should have received a copy of the GNU General
# Public License along with this program. If not, see
# <https://www.gnu.org/licenses/>.
#

config BOARD_RASPBERRY_PICO_DISCARD_IN_CONF
  bool "Raspberry Pico"

if BOARD_RASPBERRY_PICO_DISCARD_IN_CONF
  config CONFIG_BOARD
    def_string "raspberry_pico"

  config FIRMWARE_IN_FLASH 
    default y

  choice CHOICE_CPU
    default CPU_RP2040
  endchoice

  config CONFIG_BUILD_LINKER_SCRIPT_PATH
    default "${hal_root}/source/raspberry/rp2040/linker_script.ld" 

  config FLASH_MEMORY_ADDRESS
    default "0x10000000"
  
  config FLASH_MEMORY_SIZE
    default "2MB"

endif
```

## tests/smoke/configs/pimoroni_pico_plus2_and_vga_defconfig
```kconfig
# CONFIG_CUSTOM_BOARD is not set
# CONFIG_BOARD_HOST is not set
CONFIG_CONFIG_BOARD="pimoroni_pico_plus2"
# CONFIG_CONFIG_BUILD_BUNDLE_COMPILER_RT is not set
CONFIG_CONFIG_BUILD_USE_NEWLIB=y
# CONFIG_BOARD_MSPC_V2_DISCARD_IN_CONF is not set
CONFIG_CONFIG_BUILD_LINKER_SCRIPT_PATH="${hal_root}/source/raspberry/rp2350/linker_script.ld"
CONFIG_FLASH_MEMORY_ADDRESS="0x10000000"
CONFIG_FLASH_MEMORY_SIZE="2MB"
CONFIG_CONFIG_PSRAM_CS_PIN=47
CONFIG_BOARD_PIMORONI_PICO_PLUS2_DISCARD_IN_CONF=y
# CONFIG_BOARD_RASPBERRY_PICO_DISCARD_IN_CONF is not set
# CONFIG_BOARD_RASPBERRY_PICO_2_DISCARD_IN_CONF is not set

#
# CPU Configuration
#
# CONFIG_CPU_ARCH_ARM_ARMV6_M is not set
CONFIG_CONFIG_CPU_ARCH="armv8-m"
CONFIG_CPU_ARCH_ARM_ARMV8_M=y
# CONFIG_CPU_ARCH_STUB_HOST is not set
# CONFIG_CPU_CORE_ARM_CORTEX_M0_PLUS is not set
CONFIG_CPU_CORE_ARM_CORTEX_M33=y
# CONFIG_CPU_CORE_STUB_HOST is not set
# CONFIG_CPU_FAMILY_HOST is not set
CONFIG_CPU_FAMILY_RASPBERRY=y
# CONFIG_CPU_HOST is not set
CONFIG_CONFIG_CPU="rp2350"
# CONFIG_CPU_RP2040 is not set
CONFIG_CPU_RP2350=y
CONFIG_CONFIG_CPU_HAS_FPU=y
CONFIG_CONFIG_CPU_USE_FPU=y
CONFIG_CONFIG_CPU_HAS_EXTERNAL_MEMORY_INTERFACE=y
# end of CPU Configuration

#
# Build options
#
# end of Build options

#
# Memory
#
CONFIG_CPU_HAS_MPU=y

#
# PSRAM
#
# end of PSRAM
# end of Memory

#
# Process Options
#
# CONFIG_CONFIG_PROCESS_USE_MPU_STACK_PROTECTION is not set
CONFIG_CONFIG_PROCESS_USE_STACK_OVERFLOW_DETECTION=y
CONFIG_CONFIG_PROCESS_CONTEXT_SWITCH_PERIOD=20
CONFIG_CONFIG_PROCESS_ROOT_STACK_SIZE=4096
CONFIG_CONFIG_PROCESS_HW_SPINLOCK_NUMBER=5
CONFIG_CONFIG_PROCESS_CONTEXT_SWITCH_HW_SPINLOCK_NUMBER=6
# CONFIG_CONFIG_SCHEDULER_OSTHREAD is not set
CONFIG_CONFIG_SCHEDULER_ROUND_ROBIN=y
# end of Process Options

#
# Logging & Instrumentation
#
CONFIG_CONFIG_INSTRUMENTATION_ENABLE_MEMORY_LEAK_DETECTION=y
# CONFIG_CONFIG_INSTRUMENTATION_VERBOSE_ALLOCATORS is not set
# CONFIG_CONFIG_INSTRUMENTATION_PRINT_MEMORY_USAGE is not set
# CONFIG_CONFIG_INSTRUMENTATION_LOG_ERROR is not set
# CONFIG_CONFIG_INSTRUMENTATION_LOG_WARNING is not set
CONFIG_CONFIG_INSTRUMENTATION_LOG_INFO=y
# CONFIG_CONFIG_INSTRUMENTATION_LOG_DEBUG is not set
# end of Logging & Instrumentation

#
# Filesystem Options
#
CONFIG_CONFIG_FS_MAX_MOUNT_POINT_SIZE=64
CONFIG_CONFIG_FS_MAX_PATH_LENGTH=64

#
# RamFS Config
#
CONFIG_CONFIG_RAMFS_MAX_FILENAME=16
# end of RamFS Config
# end of Filesystem Options
```
