## Kconfig
```kconfig
#
# KConfig
#
# Copyright (C) 2025 Mateusz Stadnik <matgla@live.com>
#
# This program is free software: you can redistribute it and/or
# modify it under the terms of the GNU General Public License
# as published by the Free Software Foundation, either version
# 3 of the License, or (at your option) any later version.
#
# This program is distributed in the hope that it will be
# useful, but WITHOUT ANY WARRANTY; without even the implied
# warranty of MERCHANTABILITY or FITNESS FOR A PARTICULAR
# PURPOSE. See the GNU General Public License for more details.
#
# You should have received a copy of the GNU General
# Public License along with this program. If not, see
# <https://www.gnu.org/licenses/>.
#

mainmenu "Yet Another Simple Operating System"

source "./hal/KConfig"

menu "Process Options"

config CONFIG_PROCESS_USE_MPU_STACK_PROTECTION
  bool "Use MPU Stack Protection"
  help
    Use hardware unit for stack protection of process
  depends on CPU_HAS_MPU

config CONFIG_PROCESS_USE_MPU_KERNEL_PROTECTION
  bool "Protect kernel heap and stack with the MPU"
  default y
  depends on CPU_HAS_MPU
  help
    Configure the MPU at boot so that unprivileged user processes cannot access
    the kernel heap or the kernel stack. The kernel keeps full access through the
    privileged background memory map; user processes run unprivileged and may only
    touch code (flash), the romfs image and the user RAM pool. An unprivileged
    access to kernel memory faults and terminates the offending process.

    Per-process isolation (a process restricted to only its own memory) is not
    provided: PMSAv8 has no sub-regions and only 8 regions, while a process
    accumulates ~12 scattered page allocations, so its memory cannot be covered
    by static regions. This option protects the kernel only.

config CONFIG_PROCESS_USE_STACK_OVERFLOW_DETECTION
  bool "Use stack overflow detection"
  default y
  help
    Software stack overflow detection.
    This is detection, not prevention. If stack overflow occured memory may be corrupted!
    For prevention MPU must be used in hardware's that supports it.

config CONFIG_PROCESS_CONTEXT_SWITCH_PERIOD
  int "Context switch period in milliseconds"
  default 20
  help
    Context switch period in milliseconds, process may be interrupted earlier if blocked on IO

config CONFIG_PROCESS_DEFAULT_STACK_SIZE
  int "Default process stack size"
  default 32768
  help
    Default stack size for newly spawned processes, including the root process.

config CONFIG_PROCESS_MAX_STACK_SIZE
  int "Maximum process stack size"
  default 1048576
  help
    Hard stack size limit for processes. Soft stack limits may be raised up to
    this value.

config CONFIG_PROCESS_SMP
  bool "Run the scheduler on more than one core"
  default n
  help
    Whether a second core is actually brought up and scheduled on.

    This is NOT "does the chip have two cores" -- the RP2350 does, and reports
    it through hal.cpu.number_of_cores(), while YasOS still parks core 1. It is
    "is more than one core running kernel code", which is what decides whether
    cross-core synchronization has anything to do.

    With this off, the kernel keeps every atomic and every interrupt mask it has
    -- the scheduler is preemptive, so a read-modify-write shared between thread
    and handler context still races on a single core -- but drops the parts that
    only mean something between cores: the spinlock's wait/wake back-off, and
    the per-CPU arrays collapse to one slot with a compile-time-zero index.

    Turn it on with core 1 bring-up (phase 6 of docs/smp_plan.md), and on the
    host unit-test target, where the primitives are exercised under genuine
    std.Thread contention.

choice CONFIG_PROCESS_SCHEDULER
  prompt "Process Scheduler"
  help
    Select process scheduler to use.
    Round Robin scheduler is a simple scheduler that allows processes to run for a fixed time slice.
    OSThread scheduler is a stub scheduler that uses OS thread to simulate processes
config CONFIG_SCHEDULER_OSTHREAD
  bool "OSThread"
config CONFIG_SCHEDULER_ROUND_ROBIN
  bool "RoundRobinScheduler"
config CONFIG_SCHEDULER_STUB
  bool "StubScheduler"
endchoice

config CONFIG_PROCESS_MAX_PID_VALUE
  int "Max PID value"
  default 2048
  help
    Maximum PID value, after reaching this value PID will wrap around to 1

endmenu

menu "Logging & Instrumentation"
  config CONFIG_INSTRUMENTATION_ENABLE_MEMORY_LEAK_DETECTION
    prompt "Enable leak detection"
    def_bool "false"
  config CONFIG_INSTRUMENTATION_LEAK_REPORT_DEAD_ONLY
    prompt "Report leaks only from dead processes"
    def_bool "true"
    depends on CONFIG_INSTRUMENTATION_ENABLE_MEMORY_LEAK_DETECTION
  config CONFIG_INSTRUMENTATION_VERBOSE_ALLOCATORS
    prompt "Enable verbose kernel allocator"
    def_bool "false"
  config CONFIG_INSTRUMENTATION_PRINT_MEMORY_USAGE
    prompt "Enable kernel allocator memory usage"
    def_bool "false"

  config CONFIG_INSTRUMENTATION_PERF_PROFILING
    prompt "Enable performance profiling"
    def_bool "false"
    help
      Enable per-syscall cycle counting and performance profiling.
      When enabled the kernel accumulates DWT cycle counts per syscall type
      and exposes a sys_perf_dump syscall to retrieve the results.
      TCC will also emit a detailed bench breakdown when this is active.

  config CONFIG_INSTRUMENTATION_LOG_TO_SD
    prompt "Mirror kernel log to SD card (/root/logs)"
    def_bool "false"
    help
      Mirror every kernel log line to /root/logs/kernel.log on the SD card
      (rotating the previous boot to kernel.prev.log), in addition to the
      serial console. Only takes effect when /root is the MMC-backed rootfs.

      EXPERIMENTAL / may be unstable: the mirror writes synchronously from the
      logging context, and the RP2350 SDIO driver (PIO+DMA, non-reentrant) can
      bus-fault when driven from arbitrary log contexts (e.g. the dynamic
      loader). Leave disabled unless you are actively debugging and accept the
      risk; the serial console captures the same lines safely.

  choice "Log level"
    prompt "Log level"
    config CONFIG_INSTRUMENTATION_LOG_ERROR
      bool "error"
    config CONFIG_INSTRUMENTATION_LOG_WARNING
      bool "warning"
    config CONFIG_INSTRUMENTATION_LOG_INFO
      bool "info"
    config CONFIG_INSTRUMENTATION_LOG_DEBUG
      bool "debug"
 endchoice
endmenu

menu "Filesystem Options"
  rsource "source/fs/KConfig"

endmenu
```

## configs/mspc_defconfig
```kconfig
# CONFIG_CUSTOM_BOARD is not set
# CONFIG_BOARD_HOST is not set
CONFIG_CONFIG_BOARD="mspc_v2"
# CONFIG_CONFIG_BUILD_BUNDLE_COMPILER_RT is not set
CONFIG_CONFIG_BUILD_USE_NEWLIB=y
CONFIG_BOARD_MSPC_V2_DISCARD_IN_CONF=y
CONFIG_CONFIG_BUILD_LINKER_SCRIPT_PATH="${hal_root}/source/raspberry/rp2350/linker_script.ld"
CONFIG_FLASH_MEMORY_ADDRESS="0x10000000"
CONFIG_FLASH_MEMORY_SIZE="16MB"
CONFIG_CONFIG_PSRAM_CS_PIN=0
CONFIG_CONFIG_FLASH_XIP_MAX_FREQUENCY_HZ=133000000
CONFIG_CONFIG_FLASH_XIP_MAX_SELECT_US=8
CONFIG_CONFIG_PSRAM_MAX_FREQUENCY_HZ=133000000
CONFIG_CONFIG_PSRAM_CE_MAX_LOW_US=8
CONFIG_CONFIG_PSRAM_CE_MIN_DESELECT_NS=50
CONFIG_CONFIG_PSRAM_RXDELAY_LO=2
CONFIG_CONFIG_PSRAM_RXDELAY_HI=3
CONFIG_CONFIG_PSRAM_RXDELAY_HI_FREQ_THRESHOLD_HZ=90000000
# CONFIG_BOARD_PIMORONI_PICO_PLUS2_DISCARD_IN_CONF is not set
CONFIG_CONFIG_CPU_CLOCK_FREQUENCY_MHZ=150
# CONFIG_BOARD_QEMU_MPS2_AN505_DISCARD_IN_CONF is not set
# CONFIG_BOARD_QEMU_MPS3_AN524 is not set
# CONFIG_BOARD_RASPBERRY_PICO_DISCARD_IN_CONF is not set
# CONFIG_BOARD_RASPBERRY_PICO_2_DISCARD_IN_CONF is not set

#
# CPU Configuration
#
# CONFIG_CPU_ARCH_ARM_ARMV6_M is not set
CONFIG_CONFIG_CPU_ARCH="armv8-m"
CONFIG_CPU_ARCH_ARM_ARMV8_M=y
# CONFIG_CPU_ARCH_STUB_HOST is not set
# CONFIG_CPU_CORE_ARM_CORTEX_M0_PLUS is not set
CONFIG_CPU_CORE_ARM_CORTEX_M33=y
# CONFIG_CPU_CORE_STUB_HOST is not set
# CONFIG_CPU_FAMILY_ARM is not set
# CONFIG_CPU_FAMILY_HOST is not set
CONFIG_CPU_FAMILY_RASPBERRY=y
# CONFIG_CPU_QEMU_MPS2 is not set
CONFIG_CONFIG_CPU="rp2350"
CONFIG_CONFIG_CPU_HAS_FPU=y
CONFIG_CONFIG_CPU_USE_FPU=y
CONFIG_CONFIG_BUILD_USERSPACE_FP_MFPU="rp2350"
CONFIG_CONFIG_CPU_HAS_EXTERNAL_MEMORY_INTERFACE=y
# CONFIG_CPU_QEMU_MPS3 is not set
# CONFIG_CPU_HOST is not set
# CONFIG_CPU_RP2040 is not set
CONFIG_CPU_RP2350=y
CONFIG_CONFIG_CPU_HAS_DCP=y
CONFIG_CONFIG_CPU_CORE_VOLTAGE_MV=0
# end of CPU Configuration

#
# Build options
#
CONFIG_CONFIG_BUILD_USERSPACE_HARDWARE_FP=y
# end of Build options

#
# Memory
#
CONFIG_CPU_HAS_MPU=y

#
# XIP Flash
#
# end of XIP Flash

#
# PSRAM
#
# end of PSRAM

#
# SD Card
#
CONFIG_CONFIG_MMC_BUS_MODE_SPI=y
# CONFIG_CONFIG_MMC_BUS_MODE_SDIO is not set
# end of SD Card
# end of Memory

#
# Process Options
#
# CONFIG_CONFIG_PROCESS_USE_MPU_STACK_PROTECTION is not set
CONFIG_CONFIG_PROCESS_USE_MPU_KERNEL_PROTECTION=y
CONFIG_CONFIG_PROCESS_USE_STACK_OVERFLOW_DETECTION=y
CONFIG_CONFIG_PROCESS_CONTEXT_SWITCH_PERIOD=5
CONFIG_CONFIG_PROCESS_DEFAULT_STACK_SIZE=32768
CONFIG_CONFIG_PROCESS_MAX_STACK_SIZE=1048576
CONFIG_CONFIG_PROCESS_HW_SPINLOCK_NUMBER=5
CONFIG_CONFIG_PROCESS_CONTEXT_SWITCH_HW_SPINLOCK_NUMBER=6
# CONFIG_CONFIG_SCHEDULER_OSTHREAD is not set
CONFIG_CONFIG_SCHEDULER_ROUND_ROBIN=y
# CONFIG_CONFIG_SCHEDULER_STUB is not set
CONFIG_CONFIG_PROCESS_MAX_PID_VALUE=2048
# end of Process Options

#
# Logging & Instrumentation
#
# CONFIG_CONFIG_INSTRUMENTATION_ENABLE_MEMORY_LEAK_DETECTION is not set
# CONFIG_CONFIG_INSTRUMENTATION_VERBOSE_ALLOCATORS is not set
# CONFIG_CONFIG_INSTRUMENTATION_PRINT_MEMORY_USAGE is not set
# CONFIG_CONFIG_INSTRUMENTATION_PERF_PROFILING is not set
# CONFIG_CONFIG_INSTRUMENTATION_LOG_TO_SD is not set
CONFIG_CONFIG_INSTRUMENTATION_LOG_ERROR=y
# CONFIG_CONFIG_INSTRUMENTATION_LOG_WARNING is not set
# CONFIG_CONFIG_INSTRUMENTATION_LOG_INFO is not set
# CONFIG_CONFIG_INSTRUMENTATION_LOG_DEBUG is not set
# end of Logging & Instrumentation

#
# Filesystem Options
#
CONFIG_CONFIG_FS_MAX_MOUNT_POINT_SIZE=64
CONFIG_CONFIG_FS_MAX_PATH_LENGTH=64
CONFIG_CONFIG_FATFS_CACHE_LINE_SECTORS=4
CONFIG_CONFIG_FATFS_CACHE_LINES=8

#
# Temporary filesystem (/tmp)
#
CONFIG_CONFIG_TMPFS_ENABLE=y
CONFIG_CONFIG_TMPFS_MAX_FILE_SIZE=65536
CONFIG_CONFIG_TMPFS_ARENA_RESERVE=8192
CONFIG_CONFIG_TMPFS_PAGE_SIZE=256
CONFIG_CONFIG_TMPFS_SPILL_DIRECTORY="/root/tmp"
# end of Temporary filesystem (/tmp)

#
# RamFS Config
#
CONFIG_CONFIG_RAMFS_MAX_FILENAME=16
# end of RamFS Config
# end of Filesystem Options
```

## configs/pimoroni_pico_plus2_and_vga_defconfig
```kconfig
# CONFIG_CUSTOM_BOARD is not set
# CONFIG_BOARD_HOST is not set
CONFIG_CONFIG_BOARD="pimoroni_pico_plus2"
# CONFIG_CONFIG_BUILD_BUNDLE_COMPILER_RT is not set
CONFIG_CONFIG_BUILD_USE_NEWLIB=y
# CONFIG_BOARD_MSPC_V2_DISCARD_IN_CONF is not set
CONFIG_CONFIG_BUILD_LINKER_SCRIPT_PATH="${hal_root}/source/raspberry/rp2350/linker_script.ld"
CONFIG_FLASH_MEMORY_ADDRESS="0x10000000"
CONFIG_FLASH_MEMORY_SIZE="16MB"
CONFIG_CONFIG_PSRAM_CS_PIN=47
CONFIG_BOARD_PIMORONI_PICO_PLUS2_DISCARD_IN_CONF=y
CONFIG_CONFIG_FLASH_XIP_MAX_FREQUENCY_HZ=133000000
CONFIG_CONFIG_FLASH_XIP_MAX_SELECT_US=8
CONFIG_CONFIG_FLASH_XIP_DESELECT_NS=12
CONFIG_CONFIG_FLASH_XIP_CONTINUOUS_READ=y
CONFIG_CONFIG_PSRAM_MAX_FREQUENCY_HZ=133000000
CONFIG_CONFIG_PSRAM_CE_MAX_LOW_US=8
CONFIG_CONFIG_PSRAM_CE_MIN_DESELECT_NS=22
CONFIG_CONFIG_PSRAM_RXDELAY_LO=2
CONFIG_CONFIG_PSRAM_RXDELAY_HI=3
CONFIG_CONFIG_PSRAM_RXDELAY_HI_FREQ_THRESHOLD_HZ=90000000
# CONFIG_BOARD_RASPBERRY_PICO_DISCARD_IN_CONF is not set
# CONFIG_BOARD_RASPBERRY_PICO_2_DISCARD_IN_CONF is not set

#
# CPU Configuration
#
# CONFIG_CPU_ARCH_ARM_ARMV6_M is not set
CONFIG_CONFIG_CPU_ARCH="armv8-m"
CONFIG_CPU_ARCH_ARM_ARMV8_M=y
# CONFIG_CPU_ARCH_STUB_HOST is not set
# CONFIG_CPU_CORE_ARM_CORTEX_M0_PLUS is not set
CONFIG_CPU_CORE_ARM_CORTEX_M33=y
# CONFIG_CPU_CORE_STUB_HOST is not set
# CONFIG_CPU_FAMILY_HOST is not set
CONFIG_CPU_FAMILY_RASPBERRY=y
# CONFIG_CPU_HOST is not set
CONFIG_CONFIG_CPU="rp2350"
# CONFIG_CPU_RP2040 is not set
CONFIG_CPU_RP2350=y
CONFIG_CONFIG_CPU_CLOCK_FREQUENCY_MHZ=532
CONFIG_CONFIG_CPU_HAS_FPU=y
CONFIG_CONFIG_CPU_USE_FPU=y
CONFIG_CONFIG_CPU_HAS_EXTERNAL_MEMORY_INTERFACE=y
# end of CPU Configuration

#
# Build options
#
CONFIG_CONFIG_BUILD_USERSPACE_HARDWARE_FP=y
CONFIG_CONFIG_BUILD_USERSPACE_FP_MFPU="rp2350"
# end of Build options

#
# Memory
#
CONFIG_CPU_HAS_MPU=y

#
# XIP Flash
#
# end of XIP Flash

#
# PSRAM
#
# end of PSRAM

#
# SD Card
#
# CONFIG_CONFIG_MMC_BUS_MODE_SPI is not set
CONFIG_CONFIG_MMC_BUS_MODE_SDIO=y
# end of SD Card
# end of Memory

#
# Process Options
#
# CONFIG_CONFIG_PROCESS_USE_MPU_STACK_PROTECTION is not set
CONFIG_CONFIG_PROCESS_USE_STACK_OVERFLOW_DETECTION=y
CONFIG_CONFIG_PROCESS_CONTEXT_SWITCH_PERIOD=5
CONFIG_CONFIG_PROCESS_SMP=y
CONFIG_CONFIG_PROCESS_DEFAULT_STACK_SIZE=32768
CONFIG_CONFIG_PROCESS_MAX_STACK_SIZE=1048576
# CONFIG_CONFIG_SCHEDULER_OSTHREAD is not set
CONFIG_CONFIG_SCHEDULER_ROUND_ROBIN=y
# CONFIG_CONFIG_SCHEDULER_STUB is not set
CONFIG_CONFIG_PROCESS_MAX_PID_VALUE=2048
# end of Process Options

#
# Logging & Instrumentation
#
# CONFIG_CONFIG_INSTRUMENTATION_ENABLE_MEMORY_LEAK_DETECTION is not set
CONFIG_CONFIG_INSTRUMENTATION_LEAK_REPORT_DEAD_ONLY=y
# CONFIG_CONFIG_INSTRUMENTATION_VERBOSE_ALLOCATORS is not set
# CONFIG_CONFIG_INSTRUMENTATION_PRINT_MEMORY_USAGE is not set
CONFIG_CONFIG_INSTRUMENTATION_LOG_ERROR=y
# CONFIG_CONFIG_INSTRUMENTATION_LOG_WARNING is not set
# CONFIG_CONFIG_INSTRUMENTATION_LOG_INFO is not set
# CONFIG_CONFIG_INSTRUMENTATION_LOG_DEBUG is not set
# end of Logging & Instrumentation

#
# Filesystem Options
#
CONFIG_CONFIG_FS_MAX_MOUNT_POINT_SIZE=64
CONFIG_CONFIG_FS_MAX_PATH_LENGTH=64

#
# RamFS Config
#
CONFIG_CONFIG_RAMFS_MAX_FILENAME=16
# end of RamFS Config
# end of Filesystem Options
```
